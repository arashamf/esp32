## I2C_1602/main/Kconfig.projbuild
```kconfig
menu "Example Configuration"

    config BLINK_GPIO
        int "Blink GPIO number"
        range 0 48
        default 15
        help
            GPIO number (IOxx) to blink on and off or the RMT signal for the addressable LED.
			
	config SDA_GPIO
        int "SDA GPIO number"
        range 0 48
        default 21
        help
            GPIO number SDA.
 
    config SCL_GPIO
        int "SCL GPIO number"
        range 0 48
        default 22
        help
            GPIO number SCL.

endmenu
```

## bin_sem/main/Kconfig.projbuild
```kconfig
menu "Example Configuration"


    config BLINK_GPIO
        int "Blink GPIO number"
        range 0 48
        default 8 if IDF_TARGET_ESP32C3 || IDF_TARGET_ESP32H2
        default 18 if IDF_TARGET_ESP32S2
        default 48 if IDF_TARGET_ESP32S3
        default 15
        help
            GPIO number (IOxx) to blink on and off or the RMT signal for the addressable LED.
            
                     
    config PIN_NUM_MOSI
        int "MOSI pin"
        range 0 48
        default 23
        help
            MOSI pin
 
    config PIN_NUM_CLK
        int "CLK pin"
        range 0 48
        default 18
        help
            CLK pin
 
    config PIN_NUM_CS
        int "CS pin"
        range 0 48
        default 5
        help
            CS pin 
            
    config PIN_NUM_DC
        int "DC pin"
        range 0 48
        default 17
        help
            DC pin    
            
     config PIN_NUM_RESET
        int "RESET pin"
        range 0 48
        default 16
        help
            RESET pin            
                 

endmenu
```

## button/main/Kconfig.projbuild
```kconfig
menu "Example Configuration"


    config BLINK_GPIO
        int "Blink GPIO number"
        range 0 48
        default 8 if IDF_TARGET_ESP32C3 || IDF_TARGET_ESP32H2
        default 18 if IDF_TARGET_ESP32S2
        default 48 if IDF_TARGET_ESP32S3
        default 17
        help
            GPIO number (IOxx) to blink on and off or the RMT signal for the addressable LED.
            Some GPIOs are used for other purposes (flash connections, etc.) and cannot be used to blink.
            
	config BUTTON_GPIO
        int "Button GPIO number"
        range 0 48
        default 4
        help
            GPIO number Button.           
            

endmenu
```

## w25x/main/Kconfig.projbuild
```kconfig
menu "Example Configuration"


    config BLINK_GPIO
        int "Blink GPIO number"
        range 0 48
        default 8 if IDF_TARGET_ESP32C3 || IDF_TARGET_ESP32H2
        default 18 if IDF_TARGET_ESP32S2
        default 48 if IDF_TARGET_ESP32S3
        default 17
        help
            GPIO number (IOxx) to blink on and off or the RMT signal for the addressable LED.
            Some GPIOs are used for other purposes (flash connections, etc.) and cannot be used to blink.
            
	config BUTTON_GPIO
        int "Button GPIO number"
        range 0 48
        default 4
        help
            GPIO number Button.  
                     
    config PIN_NUM_MOSI
        int "MOSI pin"
        range 0 48
        default 23
        help
            MOSI pin

    config PIN_NUM_MISO
        int "MISO pin"
        range 0 48
        default 19
        help
            MISO pin
 
    config PIN_NUM_CLK
        int "CLK pin"
        range 0 48
        default 18
        help
            CLK pin
 
    config PIN_NUM_CS
        int "CS pin"
        range 0 48
        default 5
        help
            CS pin              

endmenu
```

## wifi_sta_udp_client/main/Kconfig.projbuild
```kconfig
# put here your custom config value
menu "Example Configuration"
    config BLINK_GPIO
        int "Blink GPIO number"
        range 0 48
        default 15
        help
            GPIO number (IOxx) to blink on and off or the RMT signal for the addressable LED.
			
	config SDA_GPIO
        int "SDA GPIO number"
        range 0 48
        default 21
        help
            GPIO number SDA.
 
    config SCL_GPIO
        int "SCL GPIO number"
        range 0 48
        default 22
        help
            GPIO number SCL. 
			
config ESP_WIFI_SSID
    string "WiFi SSID"
    default "myssid"
    help
	SSID (network name) for the example to connect to.

config ESP_WIFI_PASSWORD
    string "WiFi Password"
    default "mypassword"
    help
	WiFi password (WPA or WPA2) for the example to use.
	
config ESP_MAXIMUM_RETRY
    int "Maximum retry"
    default 5
    help
        Set the Maximum retry to avoid station reconnecting to the AP unlimited when the AP is really inexistent.
		
config SERVER_IP
    string "SERVER IPV4 Address"
    default "192.168.1.16"
    help
        SERVER IPV4 Address.
 
config SERVER_PORT
    int "Server Port"
    range 0 65535
    default 3333
    help
        The remote port.
 
config CLIENT_PORT
    int "Client Port"
    range 0 65535
    default 4444
    help
        The local port.
		
endmenu
```
